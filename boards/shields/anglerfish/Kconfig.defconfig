## boards/shields/anglerfish/Kconfig.defconfig
```kconfig
if SHIELD_ANGLERFISH_LEFT

config ZMK_KEYBOARD_NAME
    default "anglerfish"

config ZMK_SPLIT_ROLE_CENTRAL
    default y

endif # SHIELD_ANGLERFISH_LEFT

if SHIELD_ANGLERFISH_LEFT || SHIELD_ANGLERFISH_RIGHT

config ZMK_SPLIT
    default y

endif # SHIELD_ANGLERFISH_LEFT || SHIELD_ANGLERFISH_RIGHT
```
